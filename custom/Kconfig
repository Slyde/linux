## custom/Kconfig
```kconfig
menuconfig CUSTOM_FEATURES
	tristate "Enable the custom features"
	---help---
	Enable the custom features


if CUSTOM_FEATURES

config MANUAL_PANIC
	tristate "Automatically fire a kernel panic !"
	---help---
	This is only made to test the custom panic handler

config MY_PANIC
	tristate "Custom panic handler"
	---help---
	Enable the custom panic handler that will be called when a panic occure

endif
```
